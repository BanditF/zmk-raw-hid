## Kconfig
```kconfig
config RAW_HID
    bool "Enable Raw HID"
    depends on !ZMK_SPLIT || ZMK_SPLIT_ROLE_CENTRAL
    imply USB_DEVICE_HID

config RAW_HID_USAGE_PAGE
    hex "Raw HID Usage Page"
    default 0xFF60

config RAW_HID_USAGE
    hex "Raw HID Usage"
    default 0x61

config RAW_HID_REPORT_SIZE
    int "Raw HID Report Size"
    default 32

config RAW_HID_QUEUE_SIZE
    int "Raw HID reports waiting while a transfer is in flight"
    default 8
    range 1 64
    help
      Reports sent while the USB endpoint is busy wait here and go out in order after the
      endpoint's done callback; when it is full the oldest waiting report is dropped.

config RAW_HID_DEVICE
    string "Raw HID Device"
    default HID_1
```
